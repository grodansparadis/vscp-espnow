/* ******************************************************************************
 * VSCP (Very Simple Control Protocol)
 * http://www.vscp.org
 *
 * The MIT License (MIT)
 *
 * Copyright © 2000-2025 Ake Hedman, the VSCP project <info@vscp.org>
 *
 * Permission is hereby granted, free of charge, to any person obtaining a copy
 * of this software and associated documentation files (the "Software"), to deal
 * in the Software without restriction, including without limitation the rights
 * to use, copy, modify, merge, publish, distribute, sublicense, and/or sell
 * copies of the Software, and to permit persons to whom the Software is
 * furnished to do so, subject to the following conditions:
 *
 * The above copyright notice and this permission notice shall be included in all
 * copies or substantial portions of the Software.
 *
 * THE SOFTWARE IS PROVIDED "AS IS", WITHOUT WARRANTY OF ANY KIND, EXPRESS OR
 * IMPLIED, INCLUDING BUT NOT LIMITED TO THE WARRANTIES OF MERCHANTABILITY,
 * FITNESS FOR A PARTICULAR PURPOSE AND NONINFRINGEMENT. IN NO EVENT SHALL THE
 * AUTHORS OR COPYRIGHT HOLDERS BE LIABLE FOR ANY CLAIM, DAMAGES OR OTHER
 * LIABILITY, WHETHER IN AN ACTION OF CONTRACT, TORT OR OTHERWISE, ARISING FROM,
 * OUT OF OR IN CONNECTION WITH THE SOFTWARE OR THE USE OR OTHER DEALINGS IN THE
 * SOFTWARE.
 *
 *  This file is part of VSCP - Very Simple Control Protocol
 *  http://www.vscp.org
 *
 * ******************************************************************************
 */

/*
 Packages can be sent open or encrypted. If encryptet they are encrypted
 with AES-128 CBC mode.  The freme is sent as

 | 0xAA | 0x55 | ttl (1 byte) | seq (1 byte) | Packet type & encryption settings (1 byte) || AES-128 CBC encrypted data
 (event) || IV (16-byte) |

 The IV is the last 16 bytes after the encrypted data and this is a rendom value
 generated by the sender of the frame. Only present if encryption is used.

 seq is a 16-bit sequence counter that is incremented for every frame sent. It is used
 to detect if a frame is lost and to detect if a frame is a duplicate.

 esp-now max-frame size is 250 bytes. The max size for a VSCP frame is 512 bytes so a full
 level II frame must be truncated. That is 250-4-14-16 = 216 bytes is the maximum data
 size.

 Packet type & encryption settings.
 ----------------------------------
 7,6,5,4 	Packet type. Currently always one.
 3,2,1,0 	Encryption. Always one for AES-128 CBC encryption.

 Format for the VSCP frame
 -------------------------

 0 	    VSCP Level II Head MSB
 1 	    VSCP Level II Head LSB
 2 	    Timestamp microseconds MSB
 3 	    Timestamp microseconds
 4 	    Timestamp microseconds
 5 	    Timestamp microseconds LSB
 6 	    CLASS MSB
 7 	    CLASS LSB
 8 	    TYPE MSB
 9 	    TYPE LSB
 10-n 	  data ... limited to max 217 bytes
 len-2 	CRC MSB (Calculated on HEAD + CLASS + TYPE + ADDRESS + SIZE + DATA…)
 len-1 	CRC LSB

 time and guid has been left out in type 2 as they are obvious from the
 context of the frame.

 For a node that is not implementing any VSCP functionality (registers, MDF etc)
 bit 15 of the header should be set.  Note also that neader bytes 0,1,2 is used for
  a rolling index and should be updated for each frame appropriatly.
*/

#include <stdio.h>
#include <stdlib.h>
#include <string.h>
#include <sys/param.h>
#include <sys/unistd.h>
#include <sys/time.h>

#include <freertos/FreeRTOS.h>
#include "freertos/semphr.h"
#include "freertos/timers.h"
#include <freertos/event_groups.h>
#include <freertos/queue.h>
#include <freertos/task.h>

#include <mbedtls/aes.h>

#include <esp_check.h>
#include <esp_crc.h>
#include <esp_log.h>
#include <esp_mac.h>
#include "esp_netif.h"
#include "esp_now.h"
#include "esp_random.h"
#include "esp_wifi.h"
#include <esp_timer.h>
#include <nvs_flash.h>
#include <esp_wifi.h>
#include <esp_wifi_types.h>

#include <protocomm.h>
#include <protocomm_security1.h>

#include <cJSON.h>

#include "vscp-compiler.h"
#include "vscp-projdefs.h"

#include <vscp.h>
#include <crc.h>
#include <vscp-firmware-helper.h>
#include <vscp-firmware-level2.h>

#include "broadcast-bloom-filter.h"

#include "vscp-espnow.h"

// External from main
extern nvs_handle_t g_nvsHandle;
extern node_persistent_config_t g_persistent;

// Debug tag
static const char *TAG = "vscp-espnow";

/*
  This is the lowest time we will see in the system
  taken from espnow_timesync.c
*/
#define VSCP_ESPNOW_REF_TIME 1577808000 // 2020-01-01 00:00:00

// ----------------------------------------------------------------------------
//                                Globals
// ----------------------------------------------------------------------------

// True if we are in probe statebool g_vscp_espnow_probe = false;

uint8_t g_my_node_type = VSCP_DROPLET_ALPHA;

// ----------------------------------------------------------------------------
//                                 Locals
// ----------------------------------------------------------------------------

// State of the VSCP ESP-NOW state machine
static vscp_espnow_state_t s_stateVscpEspNow = VSCP_ESPNOW_STATE_IDLE;

// Sent event sequence counter
static uint8_t s_vscp_espnow_seq = 0; // Sequency counter for sent events

// Transmission statistics
static vscp_espnow_stats_t s_vscpEspNowStats;

static uint32_t s_vscp_node_reset_timer = 0;

static EventGroupHandle_t s_vscp_espnow_event_group;
#define VSCP_ESPNOW_WAIT_PROBE_RESPONSE_BIT BIT0 // Wait for probe response

// The wifi channel sequence to use for scanning
static const uint8_t s_scan_channel_sequence[] = { 1, 6, 11, 1, 6, 11, 2, 3, 4, 5, 7, 8, 9, 10, 12, 13 };
#define RESEND_SCAN_COUNT_MAX (sizeof(s_scan_channel_sequence) * 2)

// Gets initialized to our own mac
static uint8_t s_mac_self[6] = { 0 };

// Broadcast mac
static const uint8_t s_broadcast_mac[6] = { 0xff, 0xff, 0xff, 0xff, 0xff, 0Xff };

// Prefix for ethernet based GUID
static const uint8_t s_guid_prefix[] = { 0xff, 0xff, 0xff, 0xff, 0xff, 0xff, 0xff, 0xfe };

/*!
  GUID for unassigned node.
*/
static const uint8_t s_guid_unassigned[16] = { 0x00, 0x00, 0x00, 0x00, 0x00, 0x00, 0x00, 0x00,
                                               0x00, 0x00, 0x00, 0x00, 0x00, 0x00, 0x00, 0x00 };

/*!
  GUID used for a node that is uninitialized.
*/
static const uint8_t s_guid_uninitialized[16] = { 0xFF, 0xFF, 0xFF, 0xFF, 0xFF, 0xFF, 0xFF, 0xFE,
                                                  0xFF, 0xFF, 0xFF, 0xFF, 0xFF, 0xFF, 0x00, 0x00 };

// User handler for received vscp_espnow frames/events
// static vscp_event_handler_cb_t s_vscp_event_handler_cb = NULL;

// User handler for client when attaching to network
static vscp_espnow_attach_network_handler_cb_t s_vscp_espnow_attach_network_handler_cb = NULL;

// Forward declarations

// ----------------------------------------------------------------------------
//                          fifo for resend scan
// ----------------------------------------------------------------------------

// create fifo of uint16_t values
#define FIFO_SIZE 100
typedef struct {
  uint8_t buf[FIFO_SIZE];
  uint8_t head;
  uint8_t tail;
} fifo_t;

// fifo for resend scan
static fifo_t s_fifo_resend_scan;

// Get the number of elements in the fifo
#define fifo_count(fifo) ((fifo.head - fifo.tail) & (FIFO_SIZE - 1));

// Add a value to the fifo
#define fifo_push(fifo, value)                                                                                         \
  fifo.buf[fifo.head] = value;                                                                                         \
  fifo.head           = (fifo.head + 1) & (FIFO_SIZE - 1);

// Get a value from the fifo
#define fifo_pop(fifo, value)                                                                                          \
  value     = fifo.buf[fifo.tail];                                                                                     \
  fifo.tail = (fifo.tail + 1) & (FIFO_SIZE - 1);

// Clear the fifo
#define fifo_clear(fifo) fifo.head = fifo.tail = 0;

// Get the value at the head of the fifo
#define fifo_peek(fifo, value) value = fifo.buf[fifo.head];

// Check if fifo is empty
#define fifo_empty(fifo) (fifo.head == fifo.tail)

// Check if fifo is full
#define fifo_full(fifo) ((fifo.head - fifo.tail) == FIFO_SIZE)

// check if value is in fifo
bool
fifo_contains(fifo_t *fifo, uint8_t value)
{
  for (int i = fifo->tail; i != fifo->head; i = (i + 1) & (FIFO_SIZE - 1)) {
    if (fifo->buf[i] == value) {
      return true;
    }
  }

  return false;
}

// Add value to fifo and remove oldest if fifo is full
void
fifo_add(fifo_t *fifo, uint8_t value)
{
  if (fifo_full((*fifo))) {
    fifo_pop((*fifo), value);
  }

  fifo_push((*fifo), value);
}

// Get oldets value from fifo
void
fifo_get_oldest(fifo_t *fifo, uint8_t *value)
{
  fifo_pop((*fifo), *value);
}

// ----------------------------------------------------------------------------

///////////////////////////////////////////////////////////////////////////////
// vscp_espnow_send_error
//

int
vscp_espnow_send_error(uint8_t err)
{
  vscpEventEx ex;

  memset(&ex, 0, sizeof(vscpEventEx));
  ex.vscp_class = VSCP_CLASS1_ERROR;
  ex.vscp_type  = VSCP_TYPE_ERROR_ERROR;
  ex.sizeData   = 5;
  ex.data[3]    = err;
  return vscp_espnow_sendEventEx(s_broadcast_mac, &ex, 1000);
}

///////////////////////////////////////////////////////////////////////////////
// vscp_espnow_is_to_me
//

bool
vscp_espnow_is_to_me(const uint8_t *pguid)
{
  uint8_t GUID[16];
  vscp_espnow_get_node_guid(GUID);
  return (0 == memcmp(GUID, pguid, 16)) ? true : false;
}

///////////////////////////////////////////////////////////////////////////////
// vscp_espnow_get_node_guid
//

int
vscp_espnow_get_node_guid(uint8_t *pguid)
{
  esp_err_t ret;

  // Check GUID pointer
  if (NULL == pguid) {
    ESP_LOGE(TAG, "Pointer to GUID is NULL");
    return VSCP_ERROR_INVALID_POINTER;
  }

  memset(pguid, 0, 16);
  memcpy(pguid, s_guid_prefix, 8);
  ret = esp_read_mac(pguid + 8, ESP_MAC_WIFI_STA);
  if (ret != ESP_OK) {
    ESP_LOGE(TAG, "esp_efuse_mac_get_default failed to get GUID. rv=%d (%s)", ret, esp_err_to_name(ret));
  }

  pguid[14] = (g_persistent.nickname << 8) & 0xff;
  pguid[15] = g_persistent.nickname & 0xff;

  return VSCP_ERROR_SUCCESS;
}

///////////////////////////////////////////////////////////////////////////////
// vscp_espnow_getFrameBufSizeEv
//

size_t
vscp_espnow_getFrameBufSizeEv(const vscpEvent *pev)
{
  // Need event pointer
  if (NULL == pev) {
    ESP_LOGE(TAG, "Pointer to event is NULL");
    return 0;
  }

  size_t padlen = VSCP_ESPNOW_VSCP_MIN_FRAME + pev->sizeData;
  padlen        = padlen + (16 - (padlen % 16));

  return (5 + 16 + padlen); // Pre + iv + vscp + padding
}

///////////////////////////////////////////////////////////////////////////////
// vscp_espnow_getFrameBufSizeEx
//

size_t
vscp_espnow_getFrameBufSizeEx(const vscpEventEx *pex)
{
  // Need event ex pointer
  if (NULL == pex) {
    ESP_LOGE(TAG, "Pointer to event ex is NULL");
    return 0;
  }

  size_t padlen = VSCP_ESPNOW_VSCP_MIN_FRAME + pex->sizeData;
  padlen        = padlen + (16 - (padlen % 16));

  return (5 + 16 + padlen); // Pre + iv + vscp + padding
}

///////////////////////////////////////////////////////////////////////////////
// vscp_espnow_evToFrame
//

int
vscp_espnow_evToFrame(uint8_t *buf, uint8_t len, const vscpEvent *pev)
{
  // Need a buffer
  if (NULL == buf) {
    ESP_LOGE(TAG, "Pointer to buffer is NULL");
    return VSCP_ERROR_INVALID_POINTER;
  }

  // Need event
  if (NULL == pev) {
    ESP_LOGE(TAG, "Pointer to event is NULL");
    return VSCP_ERROR_INVALID_POINTER;
  }

  // Can not have data size and no pointer to data
  if (pev->sizeData && (NULL == pev->pdata)) {
    return VSCP_ERROR_PARAMETER;
  }

  // Must have room for frame
  if (len < (VSCP_ESPNOW_MIN_FRAME + pev->sizeData)) {
    ESP_LOGE(TAG, "Size of buffer is to small to fit event, len:%d", len);
    return VSCP_ERROR_PARAMETER;
  }

  memset(buf, 0, len);

  buf[VSCP_ESPNOW_POS_ID]     = VSCP_ESPNOW_ID_MSB;
  buf[VSCP_ESPNOW_POS_ID + 1] = VSCP_ESPNOW_ID_LSB;

  buf[VSCP_ESPNOW_POS_TTL] = g_persistent.ttl;

  // Set encryption and frame type (1)
  buf[VSCP_ESPNOW_POS_TYPE_VER] = 0x10 + VSCP_ENCRYPTION_AES128;

  // Set sequence count
  buf[VSCP_ESPNOW_POS_SEQ] = s_vscp_espnow_seq++;

  // Set sequence count
  buf[VSCP_ESPNOW_POS_SEQ] = s_vscp_espnow_seq++;

  // Set timestamp (in seconds)
  struct timeval tv_now;
  gettimeofday(&tv_now, NULL);
  buf[VSCP_ESPNOW_POS_TIME_STAMP]     = (tv_now.tv_sec >> 24) & 0xff;
  buf[VSCP_ESPNOW_POS_TIME_STAMP + 1] = (tv_now.tv_sec >> 16) & 0xff;
  buf[VSCP_ESPNOW_POS_TIME_STAMP + 2] = (tv_now.tv_sec >> 8) & 0xff;
  buf[VSCP_ESPNOW_POS_TIME_STAMP + 3] = tv_now.tv_sec & 0xff;

  // head
  buf[VSCP_ESPNOW_POS_HEAD]     = (pev->head >> 8) & 0xff;
  buf[VSCP_ESPNOW_POS_HEAD + 1] = (pev->head & 0xf8) + (buf[VSCP_ESPNOW_POS_SEQ] & 0x03);

  // vscp-class
  buf[VSCP_ESPNOW_POS_VSCP_CLASS]     = (pev->vscp_class >> 8) & 0xff;
  buf[VSCP_ESPNOW_POS_VSCP_CLASS + 1] = pev->vscp_class & 0xff;

  // vscp-type
  buf[VSCP_ESPNOW_POS_VSCP_TYPE]     = (pev->vscp_type >> 8) & 0xff;
  buf[VSCP_ESPNOW_POS_VSCP_TYPE + 1] = pev->vscp_type & 0xff;

  // Size of data
  if (pev->sizeData > VSCP_ESPNOW_MAX_DATA) {
    ESP_LOGE(TAG, "Size of data is to large, size: %d  Can be max: %d", pev->sizeData, VSCP_ESPNOW_MAX_DATA);
    return VSCP_ERROR_PARAMETER;
  }
  buf[VSCP_ESPNOW_POS_VSCP_LENGTH] = pev->sizeData;

  // data
  if (pev->sizeData && (NULL != pev->pdata)) {
    memcpy((buf + VSCP_ESPNOW_POS_DATA), pev->pdata, pev->sizeData);
  }
  else {
    ESP_LOGI(TAG, "No data in event");
  }

  // Calculate crc
  uint16_t crc = crcFast(buf + VSCP_ESPNOW_POS_HEAD, VSCP_ESPNOW_VSCP_MIN_FRAME + pev->sizeData - 2); // up to crc
  ESP_LOGV(TAG, "CRC: %04x", crc);
  buf[VSCP_ESPNOW_POS_DATA + pev->sizeData]     = (crc >> 8) & 0xff;
  buf[VSCP_ESPNOW_POS_DATA + pev->sizeData + 1] = crc & 0xff;

  // Check crc
  crc = crcFast(buf + VSCP_ESPNOW_POS_HEAD, VSCP_ESPNOW_VSCP_MIN_FRAME + pev->sizeData); // up to crc end
  ESP_LOGV(TAG, "CRC: %04x", crc);

  // Get IV (we cant copy it in yet because we don't know the position beacuse of padding)
  uint8_t iv[16];
  esp_fill_random(iv, 16);

  ESP_LOGV(TAG, "IV:");
  ESP_LOG_BUFFER_HEXDUMP(TAG, iv, 16, ESP_LOG_VERBOSE);

  ESP_LOGV(TAG, "Raw frame:");
  ESP_LOG_BUFFER_HEXDUMP(TAG, buf, VSCP_ESPNOW_MIN_FRAME + pev->sizeData, ESP_LOG_VERBOSE);

  /*
    Encrypt frame of VSCP_ESPNOW_ENCRYPTION_LENGTH + encoded_len + 1 from
    buf + VSCP_ESPNOW_POS_TYPE_VER. The resulting encrypted data may be padded
    to a multiple of 16 bytes. The resulting length for the data is returned.
    The first byte of the data to encrypt is the encryption type byte. This
    byte is not encrypted.

    The encrypted data is stored in the same buffer as the input data and will get padding
    and the iv copied in.
  */

  size_t enclen = vscp_fwhlp_encryptFrame(buf + VSCP_ESPNOW_POS_TYPE_VER,
                                          buf + VSCP_ESPNOW_POS_TYPE_VER,
                                          VSCP_ESPNOW_ENCRYPTION_LENGTH + pev->sizeData + 1,
                                          g_persistent.key,
                                          iv,
                                          VSCP_ENCRYPTION_AES128);

  ESP_LOGV(TAG, "Encrypted frame:");
  ESP_LOG_BUFFER_HEXDUMP(TAG, buf, enclen + 4, ESP_LOG_VERBOSE);

  // -------------------------------------------------------------------------------------------

#if 0
  uint8_t encoded_buf[250];
  memset(encoded_buf, 0, sizeof(encoded_buf));
  if (VSCP_ERROR_SUCCESS != vscp_fwhlp_decryptFrame(encoded_buf,
                                                    buf + VSCP_ESPNOW_POS_TYPE_VER,
                                                    enclen, // espnow frame -4
                                                    g_persistent.key,
                                                    NULL,
                                                    VSCP_ENCRYPTION_FROM_TYPE_BYTE)) {
    ESP_LOGE(TAG, "Failed to decrypt frame");
  }

  ESP_LOGD(TAG, "Raw decrypted frame:");
  ESP_LOG_BUFFER_HEXDUMP(TAG, encoded_buf, enclen, ESP_LOG_DEBUG);

  memcpy(buf + VSCP_ESPNOW_POS_TYPE_VER, encoded_buf, enclen);

  ESP_LOGD(TAG, "Decrypted frame:");
  ESP_LOG_BUFFER_HEXDUMP(TAG, buf, enclen + 4, ESP_LOG_DEBUG);

  // Check crc
  crc = crcFast(buf + VSCP_ESPNOW_POS_HEAD, VSCP_ESPNOW_VSCP_MIN_FRAME + pev->sizeData); // up to crc end
  ESP_LOGD(TAG, "CRC: %04x", crc);
#endif

  // -------------------------------------------------------------------------------------------

  return VSCP_ERROR_SUCCESS;
}

///////////////////////////////////////////////////////////////////////////////
// vscp_espnow_exToFrame
//

int
vscp_espnow_exToFrame(uint8_t *buf, uint8_t len, const vscpEventEx *pex)
{
  // Need a buffer
  if (NULL == buf) {
    ESP_LOGE(TAG, "Pointer to buffer is NULL");
    return VSCP_ERROR_INVALID_POINTER;
  }

  // Need event
  if (NULL == pex) {
    ESP_LOGE(TAG, "Pointer to event is NULL");
    return VSCP_ERROR_INVALID_POINTER;
  }

  // Must have room for frame
  if (len < (VSCP_ESPNOW_MIN_FRAME + pex->sizeData)) {
    ESP_LOGE(TAG, "Size of buffer is to small to fit event, len:%d", len);
    return VSCP_ERROR_PARAMETER;
  }

  memset(buf, 0, len);

  buf[VSCP_ESPNOW_POS_ID]     = VSCP_ESPNOW_ID_MSB;
  buf[VSCP_ESPNOW_POS_ID + 1] = VSCP_ESPNOW_ID_LSB;

  buf[VSCP_ESPNOW_POS_TTL] = g_persistent.ttl;

  // Set encryption and frame type (1)
  buf[VSCP_ESPNOW_POS_TYPE_VER] = 0x10 + VSCP_ENCRYPTION_AES128;

  // Set sequence count
  buf[VSCP_ESPNOW_POS_SEQ] = s_vscp_espnow_seq++;

  // Set timestamp (in seconds)
  struct timeval tv_now;
  gettimeofday(&tv_now, NULL);
  buf[VSCP_ESPNOW_POS_TIME_STAMP]     = (tv_now.tv_sec >> 24) & 0xff;
  buf[VSCP_ESPNOW_POS_TIME_STAMP + 1] = (tv_now.tv_sec >> 16) & 0xff;
  buf[VSCP_ESPNOW_POS_TIME_STAMP + 2] = (tv_now.tv_sec >> 8) & 0xff;
  buf[VSCP_ESPNOW_POS_TIME_STAMP + 3] = tv_now.tv_sec & 0xff;

  // head
  buf[VSCP_ESPNOW_POS_HEAD]     = (pex->head >> 8) & 0xff;
  buf[VSCP_ESPNOW_POS_HEAD + 1] = (pex->head & 0xf8) + (buf[VSCP_ESPNOW_POS_SEQ] & 0x03);

  // vscp-class
  buf[VSCP_ESPNOW_POS_VSCP_CLASS]     = (pex->vscp_class >> 8) & 0xff;
  buf[VSCP_ESPNOW_POS_VSCP_CLASS + 1] = pex->vscp_class & 0xff;

  // vscp-type
  buf[VSCP_ESPNOW_POS_VSCP_TYPE]     = (pex->vscp_type >> 8) & 0xff;
  buf[VSCP_ESPNOW_POS_VSCP_TYPE + 1] = pex->vscp_type & 0xff;

  // Size of data
  if (pex->sizeData > VSCP_ESPNOW_MAX_DATA) {
    ESP_LOGE(TAG, "Size of data is to large, size: %d  Can be max: %d", pex->sizeData, VSCP_ESPNOW_MAX_DATA);
    return VSCP_ERROR_PARAMETER;
  }
  buf[VSCP_ESPNOW_POS_VSCP_LENGTH] = pex->sizeData;

  // data
  if (pex->sizeData) {
    memcpy((buf + VSCP_ESPNOW_POS_DATA), pex->data, pex->sizeData);
  }

  // Calculate crc
  uint16_t crc = crcFast(buf + VSCP_ESPNOW_POS_HEAD, VSCP_ESPNOW_VSCP_MIN_FRAME + pex->sizeData - 2); // up to crc
  ESP_LOGI(TAG, "CRC: %04x", crc);
  buf[VSCP_ESPNOW_POS_DATA + pex->sizeData]     = (crc >> 8) & 0xff;
  buf[VSCP_ESPNOW_POS_DATA + pex->sizeData + 1] = crc & 0xff;

  // Check crc
  crc = crcFast(buf + VSCP_ESPNOW_POS_HEAD, VSCP_ESPNOW_VSCP_MIN_FRAME + pex->sizeData); // up to crc end
  ESP_LOGI(TAG, "CRC: %04x", crc);

  // Get IV (we cant copy it in yet because we don't know the position beacuse of padding)
  uint8_t iv[16];
  esp_fill_random(iv, 16);

  ESP_LOGD(TAG, "IV:");
  ESP_LOG_BUFFER_HEXDUMP(TAG, iv, 16, ESP_LOG_DEBUG);

  ESP_LOGD(TAG, "Raw frame:");
  ESP_LOG_BUFFER_HEXDUMP(TAG, buf, VSCP_ESPNOW_MIN_FRAME + pex->sizeData - 16, ESP_LOG_DEBUG);

  /*
    Encrypt frame of VSCP_ESPNOW_ENCRYPTION_LENGTH + encoded_len + 1 from
    buf + VSCP_ESPNOW_POS_TYPE_VER. The resulting encrypted data may be padded
    to a multiple of 16 bytes. The resulting length for the data is returned.
    The first byte of the data to encrypt is the encryption type byte. This
    byte is not encrypted.

    The encrypted data is stored in the same buffer as the input data and will get padding
    and the iv copied in.
  */

  size_t enclen = vscp_fwhlp_encryptFrame(buf + VSCP_ESPNOW_POS_TYPE_VER,
                                          buf + VSCP_ESPNOW_POS_TYPE_VER,
                                          VSCP_ESPNOW_ENCRYPTION_LENGTH + pex->sizeData + 1,
                                          g_persistent.key,
                                          iv,
                                          VSCP_ENCRYPTION_AES128);

  ESP_LOGD(TAG, "Encrypted frame: %d", enclen);
  ESP_LOG_BUFFER_HEXDUMP(TAG, buf, enclen + 4, ESP_LOG_DEBUG);

  // -------------------------------------------------------------------------------------------

#if 0
  uint8_t encoded_buf[250];
  memset(encoded_buf, 0, sizeof(encoded_buf));
  if (VSCP_ERROR_SUCCESS != vscp_fwhlp_decryptFrame(encoded_buf,
                                                    buf + VSCP_ESPNOW_POS_TYPE_VER,
                                                    enclen,
                                                    g_persistent.key,
                                                    NULL,
                                                    VSCP_ENCRYPTION_FROM_TYPE_BYTE)) {
    ESP_LOGE(TAG, "Failed to decrypt frame");
  }

  memcpy(encoded_buf + enclen - 16, iv, 16);

  ESP_LOGD(TAG, "Raw decrypted frame:");
  ESP_LOG_BUFFER_HEXDUMP(TAG, encoded_buf, enclen, ESP_LOG_DEBUG);

  memcpy(buf + VSCP_ESPNOW_POS_TYPE_VER, encoded_buf, enclen);

  ESP_LOGI(TAG, "Decrypted frame:");
  ESP_LOG_BUFFER_HEXDUMP(TAG, buf, enclen + 4, ESP_LOG_DEBUG);

  // Check crc
  crc = crcFast(buf + VSCP_ESPNOW_POS_HEAD, VSCP_ESPNOW_MIN_FRAME - 16 + pev->sizeData - 5); // up to crc end
  ESP_LOGD(TAG, "CRC: %04x", crc);
#endif

  // -------------------------------------------------------------------------------------------

  return VSCP_ERROR_SUCCESS;
}

///////////////////////////////////////////////////////////////////////////////
// vscp_espnow_frameToEv
//

int
vscp_espnow_frameToEv(vscpEvent *pev, const uint8_t *buf, uint8_t len, const uint8_t *mac)
{
  // Need event
  if (NULL == pev) {
    ESP_LOGE(TAG, "Pointer to event is NULL");
    return VSCP_ERROR_INVALID_POINTER;
  }

  // Must be at least have min size
  if (len < VSCP_ESPNOW_MIN_FRAME) {
    ESP_LOGE(TAG, "esp-now data is too short, len:%d", len);
    return VSCP_ERROR_MTU;
  }

  // Must have valid packet type byte
  if ((buf[VSCP_ESPNOW_POS_ID] != 0x55) || (buf[VSCP_ESPNOW_POS_ID + 1] != 0xAA)) {
    ESP_LOGE(TAG, "esp-now data is an invalid frame");
    return VSCP_ERROR_INVALID_FRAME;
  }

  // Must have valid frame version
  if ((buf[VSCP_ESPNOW_POS_TYPE_VER] & 0xf0) != 0x10) {
    ESP_LOGE(TAG, "Frame has invalid frame type id=0x%02x", buf[VSCP_ESPNOW_POS_TYPE_VER]);
    return VSCP_ERROR_INVALID_FRAME;
  }

  // Must have valid encryption settings
  if ((buf[VSCP_ESPNOW_POS_TYPE_VER] & 0x0f) != VSCP_ENCRYPTION_AES128) {
    ESP_LOGE(TAG, "Frame has invalid encryption id=0x%02x", buf[VSCP_ESPNOW_POS_TYPE_VER]);
    return VSCP_ERROR_INVALID_FRAME;
  }

  ESP_LOGD(TAG, "Encrypted frame: %d", len);
  ESP_LOG_BUFFER_HEXDUMP(TAG, buf, len, ESP_LOG_DEBUG);

  // Decrypt the frame
  uint8_t *encbuf = calloc(1, len);
  if (NULL == encbuf) {
    ESP_LOGE(TAG, "Failed to allocate memory for encrypted buffer");
    return VSCP_ERROR_MEMORY;
  }

  // Save start bytes (to maintain byte offset later)
  memcpy(encbuf, buf, VSCP_ESPNOW_POS_TYPE_VER);

  if (VSCP_ERROR_SUCCESS != vscp_fwhlp_decryptFrame(encbuf + VSCP_ESPNOW_POS_TYPE_VER,
                                                    buf + VSCP_ESPNOW_POS_TYPE_VER,
                                                    len - 4, // do not include frame start bytes
                                                    g_persistent.key,
                                                    NULL,
                                                    VSCP_ENCRYPTION_FROM_TYPE_BYTE)) {
    free(encbuf);
    ESP_LOGE(TAG, "Failed to decrypt frame");
  }

  ESP_LOGD(TAG, "Raw decrypted frame: %d", len - 16);
  ESP_LOG_BUFFER_HEXDUMP(TAG, encbuf, len - 16, ESP_LOG_DEBUG);

  // Check CRC (calculated over crc should give zero)
  ESP_LOGD(TAG, "Length of data=%d", encbuf[VSCP_ESPNOW_POS_VSCP_LENGTH]);
  uint16_t crc = crcFast(encbuf + VSCP_ESPNOW_POS_HEAD, len - 16 - 3); // exclude start + seq
  if (crc) {
    free(encbuf);
    ESP_LOGE(TAG, "CRC error in frame crc=0x%04X", crc);
    return VSCP_ERROR_INVALID_CHECKSUM;
  }

  // To be sure
  memset(pev, 0, sizeof(vscpEvent));

  // GUID
  if (NULL != mac) {
    memcpy(pev->GUID, s_guid_prefix, 8);
    memcpy(pev->GUID + 8, mac, 8);
  }

  // Set VSCP size
  pev->sizeData = MIN(VSCP_ESPNOW_MAX_DATA, len - VSCP_ESPNOW_MIN_FRAME);
  if (pev->sizeData) {

    pev->pdata = malloc(pev->sizeData);
    if (NULL == pev->pdata) {
      return VSCP_ERROR_MEMORY;
    }

    // Copy in data
    memcpy(pev->pdata, buf + VSCP_ESPNOW_POS_DATA, pev->sizeData);
  }

  // Head
  pev->head = construct_unsigned16(VSCP_ESPNOW_POS_HEAD, VSCP_ESPNOW_POS_HEAD + 1);

  // Timestamp
  pev->timestamp = construct_unsigned32(VSCP_ESPNOW_POS_TIME_STAMP,
                                        VSCP_ESPNOW_POS_TIME_STAMP + 1,
                                        VSCP_ESPNOW_POS_TIME_STAMP + 2,
                                        VSCP_ESPNOW_POS_TIME_STAMP + 3);

  // VSCP class
  pev->vscp_class = construct_unsigned16(VSCP_ESPNOW_POS_VSCP_CLASS, VSCP_ESPNOW_POS_VSCP_CLASS + 1);

  // VSCP type
  pev->vscp_type = construct_unsigned16(VSCP_ESPNOW_POS_VSCP_TYPE, VSCP_ESPNOW_POS_VSCP_TYPE + 1);

  free(encbuf); // Free the encoding buffer

  return VSCP_ERROR_SUCCESS;
}

///////////////////////////////////////////////////////////////////////////////
// vscp_espnow_frameToEx
//

int
vscp_espnow_frameToEx(vscpEventEx *pex, const uint8_t *buf, uint8_t len, const uint8_t *mac)
{
  // Need event
  if (NULL == pex) {
    ESP_LOGE(TAG, "Pointer to event is NULL");
    return VSCP_ERROR_INVALID_POINTER;
  }

  // Must at least have min size
  if (len < VSCP_ESPNOW_MIN_FRAME) {
    ESP_LOGE(TAG, "esp-now frame is too short, len:%d", len);
    return VSCP_ERROR_MTU;
  }

  // Must have valid packet type byte
  if ((buf[VSCP_ESPNOW_POS_ID] != 0x55) || (buf[VSCP_ESPNOW_POS_ID + 1] != 0xAA)) {
    ESP_LOGE(TAG, "esp-now data is an invalid frame");
    return VSCP_ERROR_INVALID_FRAME;
  }

  // Must have valid frame version
  if ((buf[VSCP_ESPNOW_POS_TYPE_VER] & 0xf0) != 0x10) {
    ESP_LOGE(TAG, "Frame has invalid frame type id=0x%02x", buf[VSCP_ESPNOW_POS_TYPE_VER]);
    return VSCP_ERROR_INVALID_FRAME;
  }

  // Must have valid encryption settings
  if ((buf[VSCP_ESPNOW_POS_TYPE_VER] & 0x0f) != VSCP_ENCRYPTION_AES128) {
    ESP_LOGE(TAG, "Frame has invalid encryption id=0x%02x", buf[VSCP_ESPNOW_POS_TYPE_VER]);
    return VSCP_ERROR_INVALID_FRAME;
  }

  ESP_LOGV(TAG, "Encrypted frame: %d", len);
  ESP_LOG_BUFFER_HEXDUMP(TAG, buf, len, ESP_LOG_VERBOSE);

  // Decrypt the frame
  uint8_t *encbuf = calloc(1, len);
  if (NULL == encbuf) {
    ESP_LOGE(TAG, "Failed to allocate memory for encrypted buffer");
    return VSCP_ERROR_MEMORY;
  }

  // Save start bytes (to maintain byte offset later)
  memcpy(encbuf, buf, VSCP_ESPNOW_POS_TYPE_VER);

  if (VSCP_ERROR_SUCCESS != vscp_fwhlp_decryptFrame(encbuf + VSCP_ESPNOW_POS_TYPE_VER,
                                                    buf + VSCP_ESPNOW_POS_TYPE_VER,
                                                    len - 4, // do not include frame start bytes
                                                    g_persistent.key,
                                                    NULL,
                                                    VSCP_ENCRYPTION_FROM_TYPE_BYTE)) {
    free(encbuf);
    ESP_LOGE(TAG, "Failed to decrypt frame");
  }

  ESP_LOGV(TAG, "Raw decrypted frame: %d", len - 16);
  ESP_LOG_BUFFER_HEXDUMP(TAG, encbuf, len - 16, ESP_LOG_VERBOSE);

  // Check CRC (calculated over crc should give zero)
  ESP_LOGV(TAG, "Length of data=%d", encbuf[VSCP_ESPNOW_POS_VSCP_LENGTH]);
  uint16_t crc = crcFast(encbuf + VSCP_ESPNOW_POS_HEAD, len - 16 - 3); // exclude start + seq
  if (crc) {
    free(encbuf);
    ESP_LOGE(TAG, "CRC error in frame crc=0x%04X", crc);
    return VSCP_ERROR_INVALID_CHECKSUM;
  }

  memset(pex, 0, sizeof(vscpEventEx));

  // GUID
  if (NULL != mac) {
    memcpy(pex->GUID, s_guid_prefix, 8);
    memcpy(pex->GUID + 8, mac, 8);
  }

  // Set VSCP size
  pex->sizeData = MIN(VSCP_ESPNOW_MAX_DATA, len - VSCP_ESPNOW_MIN_FRAME);
  if (pex->sizeData) {
    // Copy in data
    memcpy(pex->data, buf + VSCP_ESPNOW_POS_DATA, pex->sizeData);
  }

  // Head
  pex->head = construct_unsigned16(VSCP_ESPNOW_POS_HEAD, VSCP_ESPNOW_POS_HEAD + 1);

  // Timestamp
  pex->timestamp = construct_unsigned32(VSCP_ESPNOW_POS_TIME_STAMP,
                                        VSCP_ESPNOW_POS_TIME_STAMP + 1,
                                        VSCP_ESPNOW_POS_TIME_STAMP + 2,
                                        VSCP_ESPNOW_POS_TIME_STAMP + 3);

  // VSCP class
  pex->vscp_class = construct_unsigned16(VSCP_ESPNOW_POS_VSCP_CLASS, VSCP_ESPNOW_POS_VSCP_CLASS + 1);

  // VSCP type
  pex->vscp_type = construct_unsigned16(VSCP_ESPNOW_POS_VSCP_TYPE, VSCP_ESPNOW_POS_VSCP_TYPE + 1);

  // Free the encoding buffer
  free(encbuf);

  return VSCP_ERROR_SUCCESS;
}

///////////////////////////////////////////////////////////////////////////////
// vscp_espnow_calculate_msg_checksum
//

static uint16_t
vscp_espnow_calculate_msg_checksum(const uint8_t *msg, uint8_t len)
{
  uint16_t checksum = 0;
  for (int i = VSCP_ESPNOW_POS_TYPE_VER; i < len; i++) {
    checksum += msg[i];
  }

  return checksum;
}

///////////////////////////////////////////////////////////////////////////////
// vscp_espnow_receive_message
//

int
vscp_espnow_receive_message(const vscp_espnow_event_rcv_info_t *prcv)
{
  /*
    Have we seen this message already?

    we use a checksum calculated over the frame from VSCP_ESPNOW_POS_TYPE_VER
    to see if we have seen it before. If we have we just ignore it.

    ttl     - may be different
    seq     - may be different
    src-mac - may be different

   */

  // uint16_t checksum =
  //   vscp_espnow_calculate_msg_checksum(prcv->data + VSCP_ESPNOW_POS_TYPE_VER, prcv->size - VSCP_ESPNOW_POS_TYPE_VER);
  // if (fifo_contains(&s_fifo_resend_scan, checksum)) {
  //   ESP_LOGI(TAG, "Message already seen, we ignore it");
  //   return VSCP_ERROR_SUCCESS;
  // }

  // // We have not seen this message - Add checksum to fifo
  // fifo_add(&s_fifo_resend_scan, checksum);

  prcv->data[VSCP_ESPNOW_POS_TTL]--;

  // If we have seen this message before we don't forward it
  if (!forward_message(prcv->data, prcv->size, prcv->data[VSCP_ESPNOW_POS_TTL])) {
    ESP_LOGI(TAG, "Message already seen, we ignore it");
    return VSCP_ERROR_SUCCESS;
  }

  // Resend if there is hops left
  if (prcv->data[2] > 0) {
    ESP_LOGI(TAG, "Resending message - hops left=%d", prcv->data[2]);
    esp_err_t ret = esp_now_send(s_broadcast_mac, prcv->data, prcv->size);
    if (ESP_OK != ret) {

      if (ESP_ERR_INVALID_ARG == ret) {
        ESP_LOGE(TAG, "Invalid parameter");
        return VSCP_ERROR_PARAMETER;
      }
      else if (ESP_ERR_TIMEOUT == ret) {
        ESP_LOGE(TAG, "Timeout");
        return VSCP_ERROR_TIMEOUT;
      }
      else if (ESP_ERR_WIFI_TIMEOUT == ret) {
        ESP_LOGE(TAG, "Wifi timeout");
        return VSCP_ERROR_TIMEOUT;
      }
      else {
        ESP_LOGE(TAG, "Unknow error 0x%X %s", ret, esp_err_to_name(ret));
        return VSCP_ERROR_ERROR;
      }
    }

    // Add to seen messages
    uint16_t checksum =
      vscp_espnow_calculate_msg_checksum(prcv->data + VSCP_ESPNOW_POS_TYPE_VER, prcv->size - VSCP_ESPNOW_POS_TYPE_VER);
    fifo_add(&s_fifo_resend_scan, checksum);
  }

  // Handle the event

  vscpEventEx ex;
  int rv = vscp_espnow_frameToEx(&ex, prcv->data, prcv->size, s_broadcast_mac);
  ;
  if (VSCP_ERROR_SUCCESS != rv) {
    ESP_LOGE(TAG, "Failed to convert VSCP frame to event ex");
  }

  return VSCP_ERROR_SUCCESS;
}

///////////////////////////////////////////////////////////////////////////////
// vscp_espnow_sendEvent
//

int
vscp_espnow_sendEvent(const uint8_t *destAddr, const vscpEvent *pev, uint32_t wait_ms)
{
  int rv;
  uint8_t GUID[16];
  uint8_t *pbuf = NULL;
  size_t len    = vscp_espnow_getFrameBufSizeEv(pev);

  // Need dest address
  if (NULL == destAddr) {
    ESP_LOGE(TAG, "Pointer to destAddr is NULL");
    return VSCP_ERROR_INVALID_POINTER;
  }

  // Need event
  if (NULL == pev) {
    ESP_LOGE(TAG, "Pointer to event is NULL");
    return VSCP_ERROR_INVALID_POINTER;
  }

  pbuf = calloc(1, len);
  if (NULL == pbuf) {
    ESP_LOGE(TAG, "Failed to allocate memory for send buffer-");
    return VSCP_ERROR_MEMORY;
  }

  // If the GUID is zero we set it to the nodes GUID
  if (0 == memcmp(pev->GUID, s_guid_unassigned, 16)) {
    if (VSCP_ERROR_SUCCESS != (rv = vscp_espnow_get_node_guid(GUID))) {
      ESP_LOGE(TAG, "Failed to get GUID");
      return rv;
    }
  }

  if (VSCP_ERROR_SUCCESS != (rv = vscp_espnow_evToFrame(pbuf, len, pev))) {
    free(pbuf);
    ESP_LOGE(TAG, "Failed to convert event to frame. rv=%d (%s)", rv, esp_err_to_name(rv));
    return rv;
  }

  // ESP_LOG_BUFFER_HEXDUMP(TAG, pbuf, len, ESP_LOG_DEBUG);

  ESP_LOGD(TAG, "Send mac: " MACSTR ", version: %d", MAC2STR(destAddr), VSCP_ESPNOW_VERSION);

  esp_err_t ret = esp_now_send(destAddr, pbuf, len);
  if (ESP_OK != ret) {

    if (ESP_ERR_INVALID_ARG == ret) {
      ESP_LOGE(TAG, "Invalid parameter");
      rv = VSCP_ERROR_PARAMETER;
      goto ERROR;
    }
    else if (ESP_ERR_TIMEOUT == ret) {
      ESP_LOGE(TAG, "Timeout");
      rv = VSCP_ERROR_TIMEOUT;
      goto ERROR;
    }
    else if (ESP_ERR_WIFI_TIMEOUT == ret) {
      ESP_LOGE(TAG, "Wifi timeout");
      rv = VSCP_ERROR_TIMEOUT;
      goto ERROR;
    }
    else {
      ESP_LOGE(TAG, "Unknow error 0x%X %s", ret, esp_err_to_name(ret));
      rv = VSCP_ERROR_ERROR;
      goto ERROR;
    }
  }

  // Add to seen messages
  forward_message(pbuf, len, pbuf[VSCP_ESPNOW_POS_TTL]);
  // uint16_t checksum =
  //   vscp_espnow_calculate_msg_checksum(pbuf + VSCP_ESPNOW_POS_TYPE_VER, len - VSCP_ESPNOW_POS_TYPE_VER);
  // fifo_add(&s_fifo_resend_scan, checksum);

  rv = VSCP_ERROR_SUCCESS;

ERROR:
  free(pbuf);
  return rv;
}

//////////////////////////////////////////////////////////////////////////////////
// vscp_espnow_sendEventEx
//

int
vscp_espnow_sendEventEx(const uint8_t *destAddr, const vscpEventEx *pex, uint32_t wait_ms)
{

  int rv;
  uint8_t *pbuf;
  size_t len = vscp_espnow_getFrameBufSizeEx(pex);

  ESP_LOGI(TAG, "Send Event");

  // Need event
  if (NULL == pex) {
    ESP_LOGE(TAG, "Pointer to event ex is NULL");
    return ESP_ERR_INVALID_ARG;
  }

  // Need dest address
  if (NULL == destAddr) {
    ESP_LOGE(TAG, "Pointer to destAddr is NULL");
    return VSCP_ERROR_INVALID_POINTER;
  }

  pbuf = calloc(1, len);
  if (NULL == pbuf) {
    return ESP_ERR_NO_MEM;
  }

  if (VSCP_ERROR_SUCCESS != (rv = vscp_espnow_exToFrame(pbuf, len, pex))) {
    free(pbuf);
    ESP_LOGE(TAG, "Failed to convert event to frame. rv=%d (%s)", rv, esp_err_to_name(rv));
    return ESP_ERR_INVALID_ARG;
  }

  ESP_LOGD(TAG, "Send mac: " MACSTR ", version: %d", MAC2STR(destAddr), VSCP_ESPNOW_VERSION);

  // ESP_LOG_BUFFER_HEXDUMP(TAG, pbuf, len, ESP_LOG_DEBUG);

  esp_err_t ret = esp_now_send(destAddr, pbuf, len);
  if (ESP_OK != ret) {

    if (ESP_ERR_INVALID_ARG == ret) {
      ESP_LOGE(TAG, "Invalid parameter");
      rv = VSCP_ERROR_PARAMETER;
      goto ERROR;
    }
    else if (ESP_ERR_TIMEOUT == ret) {
      ESP_LOGE(TAG, "Timeout");
      rv = VSCP_ERROR_TIMEOUT;
      goto ERROR;
    }
    else if (ESP_ERR_WIFI_TIMEOUT == ret) {
      ESP_LOGE(TAG, "Wifi timeout");
      rv = VSCP_ERROR_TIMEOUT;
      goto ERROR;
    }
    else {
      ESP_LOGE(TAG, "Unknow error 0x%X %s", ret, esp_err_to_name(ret));
      rv = VSCP_ERROR_ERROR;
      goto ERROR;
    }
  }

  // Add to seen messages
  forward_message(pbuf, len, pbuf[VSCP_ESPNOW_POS_TTL]);
  // uint16_t checksum =
  //   vscp_espnow_calculate_msg_checksum(pbuf + VSCP_ESPNOW_POS_TYPE_VER, len - VSCP_ESPNOW_POS_TYPE_VER);
  // fifo_add(&s_fifo_resend_scan, checksum);

  rv = VSCP_ERROR_SUCCESS;

ERROR:
  free(pbuf);
  return rv;
}

///////////////////////////////////////////////////////////////////////////////
// vscp_espnow_set_vscp_user_handler_cb
//

// void
// vscp_espnow_set_vscp_user_handler_cb(vscp_event_handler_cb_t cb)
// {
//   s_vscp_event_handler_cb = cb;
// }

///////////////////////////////////////////////////////////////////////////////
// vscp_espnow_clear_vscp_handler_cb
//

// void
// vscp_espnow_clear_vscp_handler_cb(void)
// {
//   s_vscp_event_handler_cb = NULL;
// }

///////////////////////////////////////////////////////////////////////////////
// vscp_espnow_send_probe_event
//

int
vscp_espnow_send_probe_event(const uint8_t *dest_addr, uint8_t channel, TickType_t wait_ticks)
{
  int rv = VSCP_ERROR_SUCCESS;
  // esp_err_t ret = ESP_OK;

  vscpEvent *pev = vscp_fwhlp_newEvent();
  if (NULL == pev) {
    ESP_LOGE(TAG, "Failed to allocate memory for event");
    return VSCP_ERROR_MEMORY;
  }

  // GUID is data
  pev->pdata = calloc(1, 16);
  if (NULL == pev->pdata) {
    free(pev);
    ESP_LOGE(TAG, "Failed to allocate memory for event data");
    return VSCP_ERROR_MEMORY;
  }

  pev->head       = 0;
  pev->timestamp  = vscp_espnow_timestamp(); // esp_timer_get_time();
  pev->vscp_class = VSCP_CLASS1_PROTOCOL;
  pev->vscp_type  = VSCP_TYPE_PROTOCOL_NEW_NODE_ONLINE;

  // Set uninitialized
  pev->sizeData = VSCP_SIZE_GUID;
  memcpy(pev->pdata, s_guid_uninitialized, VSCP_SIZE_GUID);

  size_t len   = vscp_espnow_getFrameBufSizeEv(pev);
  uint8_t *buf = malloc(len);
  if (NULL == buf) {
    ESP_LOGE(TAG, "Failed to allocate memory for event buffer");
    vscp_fwhlp_deleteEvent(&pev);
    return VSCP_ERROR_MEMORY;
  }

  if (VSCP_ERROR_SUCCESS != (rv = vscp_espnow_evToFrame(buf, len, pev))) {
    ESP_LOGE(TAG, "Failed to convert event to frame");
    return rv;
  }

  // Set timestamp (in seconds)
  // struct timeval tv_now;
  // gettimeofday(&tv_now, NULL);
  // buf[VSCP_ESPNOW_POS_TIME_STAMP]     = (tv_now.tv_sec >> 24) & 0xff;
  // buf[VSCP_ESPNOW_POS_TIME_STAMP + 1] = (tv_now.tv_sec >> 16) & 0xff;
  // buf[VSCP_ESPNOW_POS_TIME_STAMP + 2] = (tv_now.tv_sec >> 8) & 0xff;
  // buf[VSCP_ESPNOW_POS_TIME_STAMP + 3] = tv_now.tv_sec & 0xff;

  // We set timestamp to "high value". This let the prove event
  // be accepted as an event with an initiated time by receiving nodes
  buf[VSCP_ESPNOW_POS_TIME_STAMP]     = 0xff;
  buf[VSCP_ESPNOW_POS_TIME_STAMP + 1] = 0xff;
  buf[VSCP_ESPNOW_POS_TIME_STAMP + 2] = 0xff;
  buf[VSCP_ESPNOW_POS_TIME_STAMP + 3] = 0xff;

  // espnow_frame_head_t espnowhead = {
  //   .security                = false,
  //   .broadcast               = true,
  //   .retransmit_count        = 10,
  //   .magic                   = esp_random(),
  //   .ack                     = true,
  //   .filter_adjacent_channel = true,
  //   .channel                 = channel,
  //   .forward_ttl             = 10,
  //   .forward_rssi            = -65,
  //   .filter_weak_signal      = false,
  // };

  // for (int count = 0; count < 3; ++count) {
  //   //ret = espnow_send(ESPNOW_DATA_TYPE_DATA, dest_addr, buf, len, &espnowhead, pdMS_TO_TICKS(wait_ticks));
  //   if (ESP_OK != ret) {

  //     if (ESP_ERR_INVALID_ARG == ret) {
  //       ESP_LOGE(TAG, "Invalid parameter sending probe event");
  //       rv = VSCP_ERROR_PARAMETER;
  //       goto EXIT;
  //     }
  //     else if (ESP_ERR_TIMEOUT == ret) {
  //       ESP_LOGE(TAG, "Timeout sending probe event");
  //       rv = VSCP_ERROR_TIMEOUT;
  //       goto EXIT;
  //     }
  //     else if (ESP_ERR_WIFI_TIMEOUT == ret) {
  //       ESP_LOGE(TAG, "Wifi timeout sending probe event");
  //       rv = VSCP_ERROR_TIMEOUT;
  //       goto EXIT;
  //     }
  //     else {
  //       ESP_LOGE(TAG, "Unknow error %X  sending probe event", ret);
  //       rv = VSCP_ERROR_ERROR;
  //       goto EXIT;
  //     }
  //   }
  // }

  // EXIT:
  vscp_fwhlp_deleteEvent(&pev);
  free(buf);
  return rv;
}

///////////////////////////////////////////////////////////////////////////////
// vscp_espnow_probe
//

int
vscp_espnow_probe(void)
{
  int rv = VSCP_ERROR_SUCCESS;
  int ret;
  bool bProbeAck = false;
  // uint8_t primary           = 0;
  // wifi_second_chan_t second = 0;

  ESP_LOGI(TAG, "Probe starting");

  s_stateVscpEspNow = VSCP_ESPNOW_STATE_PROBE;

  // Clear the probe response bit
  xEventGroupClearBits(s_vscp_espnow_event_group, VSCP_ESPNOW_WAIT_PROBE_RESPONSE_BIT);

  for (int i = 0; i < RESEND_SCAN_COUNT_MAX; i++) {

    ret = esp_wifi_set_channel(s_scan_channel_sequence[i % sizeof(s_scan_channel_sequence)], WIFI_SECOND_CHAN_NONE);
    if (ESP_OK != rv) {
      ESP_LOGE(TAG, "[%s, %d]: Failed to set channel !(%x)", __func__, __LINE__, ret);
    }

    rv =
      vscp_espnow_send_probe_event(s_broadcast_mac, s_scan_channel_sequence[i % sizeof(s_scan_channel_sequence)], 100);
    if (VSCP_ERROR_SUCCESS != rv) {
      ESP_LOGE(TAG, "[%s, %d]: Probe failed !(%x)", __func__, __LINE__, rv);
      return rv;
    }

    // Wait for response
    EventBits_t bits = xEventGroupWaitBits(s_vscp_espnow_event_group,
                                           VSCP_ESPNOW_WAIT_PROBE_RESPONSE_BIT,
                                           pdFALSE,
                                           pdFALSE,
                                           pdMS_TO_TICKS(100));
    if (bits & VSCP_ESPNOW_WAIT_PROBE_RESPONSE_BIT) {
      printf("Probe ack\n");
      bProbeAck = true;
      break;
    }
    // taskYIELD();
  } // for

  EventBits_t bits = xEventGroupWaitBits(s_vscp_espnow_event_group,
                                         VSCP_ESPNOW_WAIT_PROBE_RESPONSE_BIT,
                                         pdFALSE,
                                         pdFALSE,
                                         pdMS_TO_TICKS(1000));
  if (!(bits & VSCP_ESPNOW_WAIT_PROBE_RESPONSE_BIT)) {
    ESP_LOGW(TAG, "Timeout waiting for response");
    rv = VSCP_ERROR_TIMEOUT;
  }

  ESP_LOGI(TAG, "Probe ending %d", rv);

  if (!bProbeAck) {
    ESP_LOGW(TAG, "Timeout waiting for response");
    rv = VSCP_ERROR_TIMEOUT;
  }

  // #if (s_my_node_type == VSCP_DROPLET_ALPHA)
  //   s_stateVscpEspNow = VSCP_ESPNOW_STATE_IDLE;
  // #else
  //   s_stateVscpEspNow = VSCP_ESPNOW_STATE_VIRGIN;
  // #endif

  return rv;
}

///////////////////////////////////////////////////////////////////////////////
// vscp_espnow_data_cb
//
// Network cluster data is received here. If the data is valid (as far as we can tell)
// it is sent to the application event receive callback,
//

static void
vscp_espnow_data_cb(uint8_t *src_addr, uint8_t *data, size_t size, wifi_pkt_rx_ctrl_t *rx_ctrl)
{
  long long node_time; // Event node time (not VSCP timestamp)
  long diff;           // Time diff between node and our time from frame timestamp
  esp_err_t ret;
  uint8_t ch                = 0;
  wifi_second_chan_t second = WIFI_SECOND_CHAN_NONE;
  if (ESP_OK != (ret = esp_wifi_get_channel(&ch, &second))) {
    ESP_LOGE(TAG, "Failed to get wifi channel, rv = 0x%X %s", ret, esp_err_to_name(ret));
  }

  if ((src_addr == NULL) || (data == NULL) || (rx_ctrl == NULL) || (size <= 0)) {
    ESP_LOGE(TAG, "Receive cb arg error");
    return;
  }

  // ESP_LOGI(TAG,
  //          "<<< 1.) Receive event from: " MACSTR " , RSSI %d Channel %d, espnow size %zd",
  //          MAC2STR((src_addr)),
  //          rx_ctrl->rssi,
  //          rx_ctrl->channel,
  //          size);

  ESP_LOGI(TAG,
           "esp-now data received. len=%zd ch=%d (%d) src=" MACSTR " rssi=%d",
           size,
           ch,
           second,
           MAC2STR(src_addr),
           rx_ctrl->rssi);

  // Check that frame length is within limits
  // if ((size < VSCP_ESPNOW_MIN_FRAME) || (size > VSCP_ESPNOW_MAX_FRAME) ||
  //     ((data[VSCP_ESPNOW_POS_TYPE_VER] & 0x0f) > VSCP_ENCRYPTION_AES256)) {

  //   ESP_LOGE(TAG,
  //            "[%s, %d]: Frame length/type is invalid len=%d (%d) type=%d",
  //            __func__,
  //            __LINE__,
  //            size,
  //            VSCP_ESPNOW_MAX_FRAME,
  //            data[VSCP_ESPNOW_POS_TYPE_VER]);

  //   ESP_LOG_BUFFER_HEXDUMP(TAG, data, size, ESP_LOG_DEBUG);

  //   s_vscpEspNowStats.nRcvFrameFault++; // Increase receive frame faults
  //   return;
  // }

  // Check frame id and vscp espnow protocol version
  if ((data[VSCP_ESPNOW_POS_ID] != 0x55) || (data[VSCP_ESPNOW_POS_ID + 1] != 0xAA)) {
    ESP_LOGW(TAG,
             "Frame is invalid. id=%X,  protocol version=%d",
             (data[VSCP_ESPNOW_POS_ID] << 8) + data[VSCP_ESPNOW_POS_ID + 1],
             data[VSCP_ESPNOW_POS_ID + 1] & 0xf);
    return;
  }

  // uint8_t node_type  = (data[VSCP_ESPNOW_POS_TYPE_VER] >> 6) & 0x03;
  // uint8_t proto_ver  = (data[VSCP_ESPNOW_POS_TYPE_VER] >> 4) & 0x03;
  // uint8_t encryption = data[VSCP_ESPNOW_POS_TYPE_VER] & 0x07;

  struct timeval tv_now;
  gettimeofday(&tv_now, NULL);

  node_time =
    (long long) (((uint32_t) data[VSCP_ESPNOW_POS_TIME_STAMP] << 24) +
                 ((uint32_t) data[VSCP_ESPNOW_POS_TIME_STAMP + 1] << 16) +
                 ((uint32_t) data[VSCP_ESPNOW_POS_TIME_STAMP + 2] << 8) + data[VSCP_ESPNOW_POS_TIME_STAMP + 3]);

  /*
    We skip frames with node_time < VSCP_ESPNOW_REF_TIME here. For a node that
    scan for a channel, which is not initiated time wise will have a "high value"
    here that makes the fram being accepted.
  */
  if (node_time < VSCP_ESPNOW_REF_TIME) {
    ESP_LOGW(TAG, "Node time stamp is lower then reference time");
    return;
  }

  // diff = abs(node_time - (int) tv_now.tv_sec);
  diff = node_time - tv_now.tv_sec;

  ESP_LOGI(TAG, "node_time  node_time: %lld, tv_now: %lld ---------> diff: %ld\n", node_time, tv_now.tv_sec, diff);

  vscpEvent *pev = vscp_fwhlp_newEvent();
  if (NULL == pev) {
    ESP_LOGE(TAG, "[%s, %d]: Could not ", __func__, __LINE__);
    return;
  }

  if (VSCP_ERROR_SUCCESS != vscp_espnow_frameToEv(pev, data, size, s_mac_self)) {
    vscp_fwhlp_deleteEvent(&pev);
    return;
  }

  // ----------------------------------------------------------------------------
  //                             Channel Probing
  // ----------------------------------------------------------------------------

  // if (1 /* alpha */) {
  //   /*
  //     1.) When Beta and Gamma nodes are in virgin state they don't know the secret key or the
  //         channel to communicate on. Therefore a pairing has to talke place. This is done by pressing
  //         a button on a alpha-node and beta/gamma node that should be paired. Now the beta/gamma node
  //         send CLASS1_PROTOCOL, VSCP_TYPE_PROTOCOL_NEW_NODE_ONLINE on all chanels until it get a response
  //         and it then set the channel, save the address of the alpha node and initiate the key exhange
  //         process. When this is done they are part of the segment.
  //     2.) Gamma nodes also send  CLASS1_PROTOCOL, VSCP_TYPE_PROTOCOL_NEW_NODE_ONLINE when they wake up.
  //         This is just to get a response so they can synd the timestamp for further communication. Note
  //         that the gamma node needs
  //   */
  //   if (/*(VSCP_ESPNOW_STATE_PROBE == s_stateVscpEspNow) &&*/ (node_type != VSCP_DROPLET_ALPHA) &&
  //       (VSCP_CLASS1_PROTOCOL == pev->vscp_class) && (VSCP_TYPE_PROTOCOL_NEW_NODE_ONLINE == pev->vscp_type) &&
  //       (16 == pev->sizeData)) {

  //     ESP_LOGI(TAG, "Probe Alpha: New node on-line");

  //     // Send probe response if probe node is all zero or same as probing
  //     if (!memcmp(VSCP_ESPNOW_ADDR_PROBE_NODE, VSCP_ESPNOW_ADDR_NONE, 6)) {
  //       ESP_LOGI(TAG, "Sending probe event on channel %d", rx_ctrl->channel);
  //       int rv = vscp_espnow_send_probe_event(s_broadcast_mac, rx_ctrl->channel, 1000);
  //       xEventGroupSetBits(s_vscp_espnow_event_group, VSCP_ESPNOW_WAIT_PROBE_RESPONSE_BIT);
  //       s_stateVscpEspNow   = VSCP_ESPNOW_STATE_IDLE;
  //       g_vscp_espnow_probe = true;
  //     }
  //     else if (!memcmp(VSCP_ESPNOW_ADDR_PROBE_NODE, src_addr, 6)) {
  //       ESP_LOGI(TAG, "Sending addressed probe event on channel %d", rx_ctrl->channel);
  //       int rv = vscp_espnow_send_probe_event(src_addr, rx_ctrl->channel, 1000);
  //       xEventGroupSetBits(s_vscp_espnow_event_group, VSCP_ESPNOW_WAIT_PROBE_RESPONSE_BIT);
  //       s_stateVscpEspNow   = VSCP_ESPNOW_STATE_IDLE;
  //       g_vscp_espnow_probe = true;
  //     }
  //     else {
  //       ESP_LOGE(TAG, "Strange probe address: " MACSTR, MAC2STR(VSCP_ESPNOW_ADDR_PROBE_NODE));
  //     }
  //   }
  //   /*
  //     1. Beta/Gamma nodes set channel and save src address of alpha node when they get the probe respons.
  //     2. Gamma nodes also send a probe when they wakeup. To be able to communicate further they
  //        store the time also at this state.
  //   */
  // }
  // else if (0 /*(s_my_node_type == VSCP_DROPLET_BETA) || (s_my_node_type == VSCP_DROPLET_GAMMA)*/) {

  //   int ret;
  //   printf("------------------------------------------------------------------\n");
  //   if ((node_type == VSCP_DROPLET_ALPHA) && (VSCP_ESPNOW_STATE_PROBE == s_stateVscpEspNow) &&
  //       (VSCP_CLASS1_PROTOCOL == pev->vscp_class) && (VSCP_TYPE_PROTOCOL_NEW_NODE_ONLINE == pev->vscp_type) &&
  //       (16 == pev->sizeData)) {

  //     ESP_LOGI(TAG, "Probe Beta: New node on-line");

  //     xEventGroupSetBits(s_vscp_espnow_event_group, VSCP_ESPNOW_WAIT_PROBE_RESPONSE_BIT);
  //     if (ESP_OK != (ret = esp_wifi_set_channel(rx_ctrl->channel, WIFI_SECOND_CHAN_NONE))) {
  //       ESP_LOGE(TAG, "[%s, %d]: Failed to set espnow channel %X", __func__, __LINE__, ret);
  //     }

  //     // Save channel to persistent storage
  //     if (ESP_OK != (ret = nvs_set_u8(g_nvsHandle, "channel", rx_ctrl->channel))) {
  //       ESP_LOGE(TAG, "[%s, %d]: Failed to update espnow nvs channel %X", __func__, __LINE__, ret);
  //     }

  //     // Save sender MAC address of alpha node to persistent storage
  //     size_t length = 6;
  //     int rv        = nvs_set_blob(g_nvsHandle, "keyorg", src_addr, length);
  //     if (rv != ESP_OK) {
  //       ESP_LOGE(TAG, "Failed to write originating max to nvs. rv=%d", rv);
  //     }

  //     // Sync time with alpha node
  //     struct timeval tm;

  //     tm.tv_sec  = (long long int) (((uint32_t) pev->pdata[1] << 24) + ((uint32_t) pev->pdata[2] << 16) +
  //                                  ((uint32_t) pev->pdata[3] << 8) + pev->pdata[4]);
  //     tm.tv_usec = 0;

  //     ESP_LOGI(TAG, "Gamma: Setting/updating system time.");
  //     if (-1 == settimeofday(&tm, NULL)) {
  //       ESP_LOGE(TAG, "Gamma: Failed to set time.");
  //     }

  //     diff = 0;

  //     // #if (s_my_node_type == VSCP_DROPLET_GAMMA)
  //     //     struct timeval tm;

  //     //     tm.tv_sec  = (long long int) (((uint32_t) pev->pdata[1] << 24) + ((uint32_t) pev->pdata[2] << 16) +
  //     //                                  ((uint32_t) pev->pdata[3] << 8) + pev->pdata[4]);
  //     //     tm.tv_usec = 0;

  //     //     ESP_LOGI(TAG, "Gamma: Setting/updating system time.");
  //     //     if (-1 == settimeofday(&tm, NULL)) {
  //     //       ESP_LOGE(TAG, "Gamma: Failed to set time.");
  //     //     }

  //     //     diff = 0;
  //     //     //diff = abs(node_time - tv_now.tv_sec);
  //     //     //node_time - tv_now.tv_sec;
  //     // #endif
  //   }

  //   // Check if we got a heartbeat from an alpha node. If we do we set/update the time
  //   // for this node
  //   if ((node_type == VSCP_DROPLET_ALPHA) && (VSCP_CLASS1_PROTOCOL == pev->vscp_class) &&
  //       (VSCP_TYPE_PROTOCOL_SEGCTRL_HEARTBEAT == pev->vscp_type) && (pev->sizeData >= 5)) {

  //     struct timeval tm;

  //     tm.tv_sec  = (long long int) (((uint32_t) pev->pdata[1] << 24) + ((uint32_t) pev->pdata[2] << 16) +
  //                                  ((uint32_t) pev->pdata[3] << 8) + pev->pdata[4]);
  //     tm.tv_usec = 0;

  //     ESP_LOGI(TAG, "Setting/updating system time.");
  //     if (-1 == settimeofday(&tm, NULL)) {
  //       ESP_LOGE(TAG, "Failed to set time.");
  //     }

  //     diff = 0;
  //     // diff = abs(node_time - tv_now.tv_sec);
  //     // node_time - tv_now.tv_sec;
  //   }
  // }

  // ----------------------------------------------------------------
  //                   Replay protection point
  // ----------------------------------------------------------------

  /*
    Time can never be back in time. We don't accept events in that case,

    If our node have a non initiated time and the originating node is initiated the diff will be a very
    high positive value here and the frame should not be accepted because replay frames could sneak in.
    This is typically also the case for a time sync.

    If the originating node is not initiated but we are the diff will be a high negative value
    and the frame will be dropped here until time is synced.

    If both originator and we are unsynced we will have a either a negative or a positive number
    with a low value.

    If both originating node and we are initiated we will have a low value (0,1) here.
  */

  if (diff > 1) {
    ESP_LOGE(TAG, "Event have timestamp out of range. diff = %lu", diff);
    goto EXIT;
  }

  ESP_LOGI(TAG,
           "<<< 2.) esp-now data received: len=%zd ch=%d src=" MACSTR
           " rssi=%d class=%d, type=%d size-data=%d timestamp=%lX",
           size,
           rx_ctrl->channel,
           MAC2STR(src_addr),
           rx_ctrl->rssi,
           pev->vscp_class,
           pev->vscp_type,
           pev->sizeData,
           pev->timestamp);

EXIT:
  vscp_fwhlp_deleteEvent(&pev);
}

///////////////////////////////////////////////////////////////////////////////
// vscp_espnow_heartbeat_task
//
// Sent periodically as a broadcast to all zones/subzones
//

void
vscp_espnow_heartbeat_task(void *pvParameter)
{
  // time_t now;

  vscp_espnow_heart_beat_t *pconfig = (vscp_espnow_heart_beat_t *) pvParameter;
  if (NULL == pconfig) {
    ESP_LOGE(TAG, "Invalid (NULL) parameter given");
    vTaskDelete(NULL);
  }

  vscpEvent *pev = vscp_fwhlp_newEvent();
  if (NULL == pev) {
    ESP_LOGE(TAG, "Unable to allocate heartbeat event");
    goto ERROR;
  }

#if (s_my_node_type == VSCP_DROPLET_ALPHA)
  pev->pdata = calloc(1, 5);
#elif (s_my_node_type == VSCP_DROPLET_BETA)
  pev->pdata = calloc(1, 3);
#else
  pev->pdata = calloc(1, 3); // Gamma
#endif

  if (NULL == pev->pdata) {
    ESP_LOGE(TAG, "Unable to allocate heartbeat event data");
    goto ERROR;
  }

  while (true) {

    if (VSCP_ESPNOW_STATE_IDLE == s_stateVscpEspNow) {

      esp_err_t ret;
      uint8_t ch                = 0;
      wifi_second_chan_t second = 0;

      if (ESP_OK != (ret = esp_wifi_get_channel(&ch, &second))) {
        ESP_LOGE(TAG, "Failed to get wifi channel, rv = 0x%X (%s)", ret, esp_err_to_name(ret));
      }

      ESP_LOGI(TAG, "Sending heartbeat ch=%d (%d).", ch, second);

      // time(&now); // Get current time
      struct timeval tv_now;
      gettimeofday(&tv_now, NULL);

#if (s_my_node_type == VSCP_DROPLET_ALPHA)
      // Alpha node send protocol heartbeat
      pev->vscp_class = VSCP_CLASS1_PROTOCOL;
      pev->vscp_type  = VSCP_TYPE_PROTOCOL_SEGCTRL_HEARTBEAT;
      pev->sizeData   = 5;
      pev->pdata[0]   = 0x00; // CRC for GUID
      pev->pdata[1]   = (tv_now.tv_sec >> 24) & 0xff;
      pev->pdata[2]   = (tv_now.tv_sec >> 16) & 0xff;
      pev->pdata[3]   = (tv_now.tv_sec >> 8) & 0xff;
      pev->pdata[4]   = tv_now.tv_sec & 0xff;
      // printf("now=%lld  %lld\n",
      //        tv_now.tv_sec,
      //        (long long int) (((uint32_t) pev->pdata[1] << 24) + ((uint32_t) pev->pdata[2] << 16) +
      //                         ((uint32_t) pev->pdata[3] << 8) + pev->pdata[4]));
#elif (s_my_node_type == VSCP_DROPLET_BETA)
      // Beta nodes send information heartbeat
      pev->vscp_class = VSCP_CLASS1_INFORMATION;
      pev->vscp_type  = VSCP_TYPE_INFORMATION_NODE_HEARTBEAT;
      pev->sizeData   = 3;
      pev->pdata[0]   = 0xff; // index
      pev->pdata[1]   = 0xff; // zone
      pev->pdata[2]   = 0xff; // subzone
#else // Gamma nodes
      // Gamma nodes send information heartbeat
      pev->vscp_class = VSCP_CLASS1_INFORMATION;
      pev->vscp_type  = VSCP_TYPE_INFORMATION_NODE_HEARTBEAT;
      pev->sizeData   = 3;
      pev->pdata[0]   = 0xff; // index
      pev->pdata[1]   = 0xff; // zone
      pev->pdata[2]   = 0xff; // subzone
#endif

      // if (espnow_timesync_check()) {
      //   pev->timestamp = vscp_espnow_timestamp(); // esp_timer_get_time();
      //   vscp_espnow_sendEvent(s_broadcast_mac, pev, false, pdMS_TO_TICKS(1000));
      // }

    } // VSCP_ESPNOW_STATE_IDLE

    // Send heartbeat event
    vscp_espnow_sendEvent(s_broadcast_mac, pev, pdMS_TO_TICKS(1000));

    // if (espnow_timesync_check()) {
    //   pev->timestamp = vscp_espnow_timestamp(); // esp_timer_get_time();

    vTaskDelay(pdMS_TO_TICKS(VSCP_ESPNOW_HEART_BEAT_INTERVAL));

  } // while

ERROR:
  if (NULL != pev) {
    vscp_fwhlp_deleteEvent(&pev);
  }
  ESP_LOGW(TAG, "Heartbeat task exit");
  vTaskDelete(NULL);
}

///////////////////////////////////////////////////////////////////////////////
// readPersistentConfigs
//

static int
readPersistentConfigs(void)
{
  esp_err_t rv;

  // Start Delay (seconds)
  rv = nvs_get_u16(g_nvsHandle, "nickname", &g_persistent.nickname);
  switch (rv) {

    case ESP_OK:
      ESP_LOGI(TAG, "Nickname = %d", g_persistent.nickname);
      break;

    case ESP_ERR_NVS_NOT_FOUND:
      rv = nvs_set_u16(g_nvsHandle, "nickname", 0xff);
      if (rv != ESP_OK) {
        ESP_LOGE(TAG, "Failed to update nickname");
      }
      break;

    default:
      ESP_LOGE(TAG, "Error (%s) reading!", esp_err_to_name(rv));
      break;
  }

  // User id
  // size_t size = 5;
  // rv          = nvs_get_blob(g_nvsHandle, "userid", &s_vscp_persistent.userid, &size);
  // if (ESP_OK != rv) {
  //   rv = nvs_set_blob(g_nvsHandle, "userid", s_vscp_persistent.userid, size);
  //   if (rv != ESP_OK) {
  //     ESP_LOGE(TAG, "Failed to update userid");
  //   }
  // }

  rv = nvs_commit(g_nvsHandle);
  if (rv != ESP_OK) {
    ESP_LOGI(TAG, "Failed to commit updates to nvs\n");
  }

  return VSCP_ERROR_SUCCESS;
}

///////////////////////////////////////////////////////////////////////////////
// vscp_espnow_init
//

int
vscp_espnow_init(void)
{
  // esp_err_t ret  = ESP_OK;

  crcInit();

  // Set the node type for further reference
#ifdef CONFIG_APP_VSCP_NODE_TYPE_ALPHA
  g_my_node_type = VSCP_DROPLET_ALPHA;
#endif

#ifdef CONFIG_APP_VSCP_NODE_TYPE_BETA
  g_my_node_type = VSCP_DROPLET_BETA;
#endif

#ifdef CONFIG_APP_VSCP_NODE_TYPE_GAMMA
  g_my_node_type = VSCP_DROPLET_GAMMA;
#endif

  esp_now_init();

  uint32_t espnowver;
  esp_now_get_version(&espnowver);
  ESP_LOGI(TAG, "ESP-NOW version: %lu", espnowver);

  // Get our own mac
  esp_read_mac(s_mac_self, ESP_MAC_WIFI_STA);

  s_stateVscpEspNow = VSCP_ESPNOW_STATE_IDLE;

  // Create signaling bits
  s_vscp_espnow_event_group = xEventGroupCreate();

  // Start heartbeat task vscp_heartbeat_task
  vscp_espnow_heart_beat_t *pconfig = malloc(sizeof(vscp_espnow_heart_beat_t));
  if (NULL == pconfig) {
    ESP_LOGE(TAG, "Failed to allocate memory for heartbeat task");
    return VSCP_ERROR_MEMORY;
  }

  pconfig->node_type = 0;  // g_persistent.node_type;
  pconfig->freq      = 60; // 60 seconds

  /* Add broadcast peer information to peer list. */
  esp_now_peer_info_t *peer = malloc(sizeof(esp_now_peer_info_t));
  if (peer == NULL) {
    ESP_LOGE(TAG, "Malloc peer information fail");
    // vSemaphoreDelete(s_example_espnow_queue);
    // esp_now_deinit();  TODO
    return ESP_FAIL;
  }
  memset(peer, 0, sizeof(esp_now_peer_info_t));
  peer->channel = 0;
  peer->ifidx   = WIFI_IF_STA;
  peer->encrypt = false;
  memcpy(peer->peer_addr, s_broadcast_mac, ESP_NOW_ETH_ALEN);
  ESP_ERROR_CHECK(esp_now_add_peer(peer));
  free(peer);

  xTaskCreate(&vscp_espnow_heartbeat_task, "vscp_heartbeat", 1024 * 3, pconfig, tskIDLE_PRIORITY + 1, NULL);

  return VSCP_ERROR_SUCCESS;
}
